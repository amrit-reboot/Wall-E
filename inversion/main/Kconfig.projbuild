## inversion/main/Kconfig.projbuild
```kconfig
menu "Inversion hardware and tuning"
config INV_REVERSE_SENSORS
    bool "Reverse sensor order"
    default n
config INV_REVERSE_LEFT
    bool "Reverse left motor"
    default n
config INV_REVERSE_RIGHT
    bool "Reverse right motor"
    default n
config INV_SWAP_MOTORS
    bool "Swap left and right motors"
    default n
config INV_CRUISE
    int "Cruise duty percent"
    range 20 60
    default 50
config INV_CREEP
    int "Transition / ambiguity duty percent"
    range 15 50
    default 45
config INV_MIN_DUTY
    int "Minimum running duty percent (existing speed settings are raised to this)"
    range 0 60
    default 45
config INV_START_DUTY
    int "Startup boost duty percent"
    range 0 60
    default 55
config INV_START_MS
    int "Startup boost duration (ms)"
    range 0 300
    default 120
config INV_CONFIRM_MS
    int "Continuous opposite-line confirmation (ms)"
    range 10 100
    default 20
config INV_KP_X10
    int "Proportional gain times 10 (duty per sensor spacing)"
    range 0 300
    default 140
config INV_KD_X1000
    int "Derivative gain times 1000 (duty seconds per sensor spacing)"
    range 0 1000
    default 100
config INV_CALIBRATION_MS
    int "Manual black/white calibration sweep duration (ms)"
    range 3000 30000
    default 10000
endmenu
```

## maze_solver/main/Kconfig.projbuild
```kconfig
menu "Maze solver"
config MAZE_STA_SSID
    string "Optional router SSID (blank = dashboard AP only)"
    default ""
config MAZE_STA_PASSWORD
    string "Router password"
    default ""
config MAZE_REVERSE_SENSORS
    bool "Reverse physical LSA order"
    default n
config MAZE_REVERSE_LEFT
    bool "Reverse left motor direction"
    default n
config MAZE_REVERSE_RIGHT
    bool "Reverse right motor direction"
    default n
config MAZE_SWAP_MOTORS
    bool "Swap left and right motor connectors"
    default n
config MAZE_OLED
    bool "SSD1306 128x64 OLED on GPIO21/22, address 0x3c"
    default y
config MAZE_LAUNCH_MS
    int "Initial forward launch (ms)"
    range 0 1000
    default 300
config MAZE_CROSS_MS
    int "Junction sensor-to-axle advance (ms)"
    range 20 400
    default 120
endmenu
```

## maze_solver/sdkconfig.defaults
```kconfig
CONFIG_IDF_TARGET="esp32"
CONFIG_ESPTOOLPY_FLASHSIZE_4MB=y
CONFIG_PARTITION_TABLE_CUSTOM=y
CONFIG_PARTITION_TABLE_CUSTOM_FILENAME="partitions.csv"
CONFIG_FREERTOS_HZ=1000
CONFIG_ESP_MAIN_TASK_STACK_SIZE=6144
CONFIG_COMPILER_OPTIMIZATION_PERF=y
```

## maze_solver_final/main/Kconfig
```kconfig
menu "Wall-E Configuration"

menu "WiFi Config"
    config WIFI_SSID
        string "WiFi SSID"
        default "myssid"
        help
            SSID (network name) for the example to connect to.

    config WIFI_PASSWORD
        string "WiFi Password"
        default "mypassword"
        help
            WiFi password (WPA or WPA2) for the example to use.

    config MAXIMUM_RETRY
        int "Maximum retry"
        default 5
        help
            Set the Maximum retry to avoid station reconnecting to the AP unlimited when the AP is really inexistent.
endmenu

menu "mDNS Config"
    config MDNS_HOST_NAME
        string "mDNS host name (< 15 chars)"
        default "walle-tuning"
        help
            mDNS hostname used to access the tuning webpage, it should be less than 15 chars
endmenu

menu "Final maze solver"
config FINAL_BASE_DUTY
    int "Cruise duty"
    range 20 50
    default 32
config FINAL_MAX_DUTY
    int "Maximum following duty (at least cruise duty)"
    range FINAL_BASE_DUTY 50
    default 36
config FINAL_TURN_DUTY
    int "Pivot duty"
    range 20 50
    default 50
config FINAL_EXIT_RULE
    int "Exit priority: 0 straight, 1 right, 2 left"
    range 0 2
    default 0
config FINAL_NODE_MEMORY
    int "Straight-first node backtracking: 0 off, 1 on"
    range 0 1
    default 0
config FINAL_IR_ENABLED
    int "Front IR on GPIO27: 0 disconnected, 1 enabled"
    range 0 1
    default 0
config FINAL_WHITE_BOUNDARY
    int "White threshold (normalized 0-1000)"
    range 1 999
    default 820
endmenu
endmenu
```

## maze_solver_final/sdkconfig.defaults
```kconfig
CONFIG_HTTPD_MAX_REQ_HDR_LEN=1024
CONFIG_SPIFFS_OBJ_NAME_LEN=64
CONFIG_ESPTOOLPY_FLASHSIZE_4MB=y
CONFIG_PARTITION_TABLE_CUSTOM=y
CONFIG_PARTITION_TABLE_CUSTOM_FILENAME="partition_table.csv"
CONFIG_PARTITION_TABLE_FILENAME="partition_table.csv"
CONFIG_ENABLE_OLED=y
CONFIG_NUMBER_OF_SAMPLES=16
CONFIG_HTTPD_WS_SUPPORT=y

CONFIG_FREERTOS_HZ=1000
```
